## CMakeLists.txt
```
cmake_minimum_required(VERSION 3.20.0)
find_package(Zephyr REQUIRED HINTS $ENV{ZEPHYR_BASE})

project(i2c_example)

target_sources(app PRIVATE src/main.c)
target_sources(app PRIVATE src/chipcap2.c)
```

## prj.conf
```kconfig
# General config
CONFIG_ASSERT=y

CONFIG_NEWLIB_LIBC=y

#I2C
CONFIG_I2C=y
CONFIG_NRFX_TWIM1=y

# Stacks and heaps
CONFIG_MAIN_STACK_SIZE=2048
CONFIG_HEAP_MEM_POOL_SIZE=8192

# for printk FP support
CONFIG_CBPRINTF_FP_SUPPORT=y
```

## src/main.c
```c
/*
 * Copyright (c) 2018 Nordic Semiconductor ASA
 *
 * SPDX-License-Identifier: LicenseRef-BSD-5-Clause-Nordic
 */

#include <zephyr/kernel.h>
#include <stdio.h>
#include <string.h>
#include <stdlib.h>
#include <zephyr/drivers/i2c.h>
#include <zephyr/device.h>
#include "chipcap2.h"

#define TEST_BUF_SIZE 128

void scan_i2c_bus()
{
    printk("The I2C scanner started\n");
    const struct device *i2c_dev = device_get_binding(DEVICE_DT_NAME(DT_NODELABEL(i2c2)));
    int error;

    if (!i2c_dev) {
        printk("Binding failed.");
        return;
    }

    /* Demonstration of runtime configuration */
    i2c_configure(i2c_dev, I2C_SPEED_SET(I2C_SPEED_STANDARD));
    printk("Value of NRF_TWIM2->PSEL.SCL : %d \n",NRF_TWIM1->PSEL.SCL);
    printk("Value of NRF_TWIM2->PSEL.SDA : %d \n",NRF_TWIM1->PSEL.SDA);
    printk("Value of NRF_TWIM2->FREQUENCY: %d \n",NRF_TWIM1->FREQUENCY);
    printk("26738688 -> 100k\n");

    for (uint8_t i = 4; i <= 0x7F; i++) {
        struct i2c_msg msgs[1];
        uint8_t dst = 1;

        msgs[0].buf = &dst;
        msgs[0].len = 1U;
        msgs[0].flags = I2C_MSG_WRITE | I2C_MSG_STOP;

        error = i2c_transfer(i2c_dev, &msgs[0], 1, i);
        if (error == 0) {
            printk("I2C device found at address 0x%2x\n", i);
        }
    }
}


void read_chipcap2_data()
{
    CC2_SAMPLE sample;

    cc2_init();
    for (int i=0; i<20; i++)
    {
        cc2_sample_data();
        cc2_get_sample(&sample);

        printk("Sample : %d\n", i);
        printk("Temp: %2.1f\n", sample.Temp_C);
        printk("RH: %2.0f\n\n", sample.RH);
        k_sleep(K_MSEC(1000));
    }
    
}

int main(void)
{
    scan_i2c_bus();
    // read_chipcap2_data();
    return 0; 
}
```

## src/chipcap2.c
```c
/*
    Note:
        Chipcap2 application guide: https://www.cdiweb.com/datasheets/telaire-amphenol/chipcap2applicationnote.pdf
*/

#include <zephyr/kernel.h>
#include "chipcap2.h"
#include <stdio.h>
#include <zephyr/drivers/i2c.h>
#include <zephyr/device.h>

#define CC2_VALID_DATA (0x00)
#define CC2_STALE_DATA (0x01)


const struct device * get_I2C_device()
{
    const struct device *i2c_dev = device_get_binding(DEVICE_DT_NAME(DT_NODELABEL(i2c2)));
    int error;

    if (!i2c_dev) {
        printk("Binding to I2C device failed.");
        return NULL;
    }

    return i2c_dev;
}

int cc2_init()
{
    uint8_t NORMAL_OPERATION_MODE[] = {CHIPCAP2_NORMAL_OPERATION_MODE, 0, 0};
    return i2c_write(get_I2C_device(), NORMAL_OPERATION_MODE, 3, CHIPCAP2_ADDRESS);
}

static CC2_SAMPLE current;

void cc2_sample_data()
{
    struct device *i2c_device = get_I2C_device();
    uint8_t rxBuffer[] = {0, 0, 0, 0};
    int err = i2c_read(i2c_device, rxBuffer, 4, CHIPCAP2_ADDRESS);
    if (0 != err)
    {
        printk("Unable to get Chipcap2 sensor reading. i2c_read failed with error: %d", err);
        return;
    }

    // uint8_t status = rxBuffer[0] >> 6;
    float RH_H = (rxBuffer[0] & 0b00111111);
    float RH_L = rxBuffer[1];
    current.RH = ((RH_H * 256 + RH_L) / 16384) * 100;
    float TempC_H = rxBuffer[2];
    float TempC_L = rxBuffer[3] >> 4;
    current.Temp_C = ((TempC_H * 64 + TempC_L) / 16384) * 165 - 40;

    // Send a new measurement request after reading. Cannot be sent before first read
    //    uint8_t measurement_request = 1;

    err = i2c_write(i2c_device, NULL, 0, CHIPCAP2_ADDRESS);
    if (0 != err)
    {
        printk("Unable to send measurement request to Chipcap2 sensor. i2c_write failed with error: %d", err);
    }
}

void cc2_get_sample(CC2_SAMPLE *msg)
{
    memcpy(msg, &current, sizeof(current));
}
```

## src/chipcap2.h
```c
#pragma once
#include <stdint.h>

typedef struct
{
    float RH;
    float Temp_C;
} CC2_SAMPLE;

#define CHIPCAP2_ADDRESS 0x28

#define CHIPCAP2_NORMAL_OPERATION_MODE 0x80

int cc2_init();
void cc2_sample_data();
void cc2_get_sample(CC2_SAMPLE *msg);
```
